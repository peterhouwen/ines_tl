## main/Kconfig.projbuild
```kconfig
menu "GPIO configuration"

    config GPIO_INPUT_0
        int "GPIO input pin 0"
        #range ENV_GPIO_RANGE_MIN ENV_GPIO_OUT_RANGE_MAX
        default 15
        help
            GPIO pin number to be used as GPIO_INPUT_IO_0.


endmenu
```
