## components/heartbeat/Kconfig
```kconfig
menu "Heartbeat"

    config HEARTBEAT_GPIO
        int "GPIO pin number"
        #range ENV_GPIO_RANGE_MIN ENV_GPIO_OUT_RANGE_MAX
        default 25
        help
            The GPIO pin number to which the LED is connected.

endmenu
```
